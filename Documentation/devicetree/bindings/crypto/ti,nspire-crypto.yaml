## Documentation/devicetree/bindings/crypto/ti,nspire-crypto.yaml
```yaml
# SPDX-License-Identifier: (GPL-2.0-only OR BSD-2-Clause)
%YAML 1.2
---
$id: http://devicetree.org/schemas/crypto/ti,nspire-crypto.yaml#
$schema: http://devicetree.org/meta-schemas/core.yaml#

title: TI-Nspire SHA-256 and triple DES engines

maintainers:
  - Krzysztof Kozlowski <krzk@kernel.org>

properties:
  compatible:
    enum:
      - ti,nspire-des
      - ti,nspire-sha256

  reg:
    maxItems: 1

required:
  - compatible
  - reg

additionalProperties: false

examples:
  - |
    crypto@cc000000 {
        compatible = "ti,nspire-sha256";
        reg = <0xcc000000 0x1000>;
    };
```

## Documentation/devicetree/bindings/iio/adc/ti,nspire-adc.yaml
```yaml
# SPDX-License-Identifier: (GPL-2.0-only OR BSD-2-Clause)
%YAML 1.2
---
$id: http://devicetree.org/schemas/iio/adc/ti,nspire-adc.yaml#
$schema: http://devicetree.org/meta-schemas/core.yaml#

title: TI-Nspire analog-to-digital converter

maintainers:
  - Krzysztof Kozlowski <krzk@kernel.org>

description:
  Seven channel ADC found in TI-Nspire calculators. Channels 1 (VBATT),
  2 (VSYS) and 4 (B12) monitor the batteries and channel 3 identifies the
  attached keypad.

properties:
  compatible:
    const: ti,nspire-adc

  reg:
    maxItems: 1

  interrupts:
    maxItems: 1

  "#io-channel-cells":
    const: 1

required:
  - compatible
  - reg
  - interrupts

additionalProperties: false

examples:
  - |
    adc@c4000000 {
        compatible = "ti,nspire-adc";
        reg = <0xc4000000 0x1000>;
        interrupts = <11>;
    };
```

## Documentation/devicetree/bindings/leds/backlight/ti,nspire-backlight.yaml
```yaml
# SPDX-License-Identifier: (GPL-2.0-only OR BSD-2-Clause)
%YAML 1.2
---
$id: http://devicetree.org/schemas/leds/backlight/ti,nspire-backlight.yaml#
$schema: http://devicetree.org/meta-schemas/core.yaml#

title: TI-Nspire LCD backlight / contrast control

maintainers:
  - Krzysztof Kozlowski <krzk@kernel.org>

description:
  The HDQ/1-Wire block of TI-Nspire calculators contains a register that
  sets the LCD backlight brightness on the colour CX models and the LCD
  contrast on the grayscale classic models.

properties:
  compatible:
    enum:
      - ti,nspire-classic-contrast
      - ti,nspire-cx-backlight

  reg:
    maxItems: 1

required:
  - compatible
  - reg

additionalProperties: false

examples:
  - |
    backlight@900f0000 {
        compatible = "ti,nspire-cx-backlight";
        reg = <0x900f0000 0x1000>;
    };
```

## Documentation/devicetree/bindings/leds/ti,nspire-led.yaml
```yaml
# SPDX-License-Identifier: (GPL-2.0-only OR BSD-2-Clause)
%YAML 1.2
---
$id: http://devicetree.org/schemas/leds/ti,nspire-led.yaml#
$schema: http://devicetree.org/meta-schemas/core.yaml#

title: TI-Nspire status LED

maintainers:
  - Krzysztof Kozlowski <krzk@kernel.org>

description:
  A green and a red LED (yellow when both are on) next to the keypad of
  TI-Nspire calculators.

properties:
  compatible:
    const: ti,nspire-led

  reg:
    maxItems: 1

  "#address-cells":
    const: 1

  "#size-cells":
    const: 0

patternProperties:
  "^led@[01]$":
    type: object
    $ref: common.yaml#
    unevaluatedProperties: false
    description: Green LED (0) or red LED (1)

    properties:
      reg:
        enum: [0, 1]

    required:
      - reg

required:
  - compatible
  - reg

additionalProperties: false

examples:
  - |
    #include <dt-bindings/leds/common.h>

    led-controller@90110000 {
        compatible = "ti,nspire-led";
        reg = <0x90110000 0x1000>;
        #address-cells = <1>;
        #size-cells = <0>;

        led@0 {
            reg = <0>;
            color = <LED_COLOR_ID_GREEN>;
            function = LED_FUNCTION_STATUS;
        };

        led@1 {
            reg = <1>;
            color = <LED_COLOR_ID_RED>;
            function = LED_FUNCTION_STATUS;
        };
    };
```

## Documentation/devicetree/bindings/mfd/ti,nspire-pwr.yaml
```yaml
# SPDX-License-Identifier: (GPL-2.0-only OR BSD-2-Clause)
%YAML 1.2
---
$id: http://devicetree.org/schemas/mfd/ti,nspire-pwr.yaml#
$schema: http://devicetree.org/meta-schemas/core.yaml#

title: TI-Nspire power management block

maintainers:
  - Krzysztof Kozlowski <krzk@kernel.org>

description:
  Register block controlling the clock dividers, peripheral bus access and
  low-power mode of TI-Nspire calculators. It also reports the state of the
  ON key, which is not part of the keypad matrix.

properties:
  compatible:
    items:
      - const: ti,nspire-pwr
      - const: syscon
      - const: simple-mfd

  reg:
    maxItems: 1

  power-button:
    type: object
    description:
      The ON key. Its interrupt line is shared with the unmaskable
      clock-change-done event of this block.
    additionalProperties: false

    properties:
      compatible:
        const: ti,nspire-power-button

      interrupts:
        maxItems: 1

    required:
      - compatible
      - interrupts

required:
  - compatible
  - reg

additionalProperties: false

examples:
  - |
    pwr@900b0000 {
        compatible = "ti,nspire-pwr", "syscon", "simple-mfd";
        reg = <0x900b0000 0x1000>;

        power-button {
            compatible = "ti,nspire-power-button";
            interrupts = <15>;
        };
    };
```

## Documentation/devicetree/bindings/mtd/ti,nspire-nand.yaml
```yaml
# SPDX-License-Identifier: (GPL-2.0-only OR BSD-2-Clause)
%YAML 1.2
---
$id: http://devicetree.org/schemas/mtd/ti,nspire-nand.yaml#
$schema: http://devicetree.org/meta-schemas/core.yaml#

title: TI-Nspire NAND flash controllers

maintainers:
  - Krzysztof Kozlowski <krzk@kernel.org>

description: |
  The CX models use an ARM PL351 static memory controller: its configuration
  registers, and a window whose address bits encode NAND commands, address
  cycle counts and data phases. The classic models use a controller that runs
  a whole command/address/data sequence and moves the data by DMA.

  Both are driven with the ECC layout of the TI-Nspire OS.

allOf:
  - $ref: nand-controller.yaml

properties:
  compatible:
    enum:
      - ti,nspire-classic-nand
      - ti,nspire-cx-nand

  reg:
    minItems: 1
    items:
      - description: controller registers
      - description: command/data window (CX)

  reg-names:
    items:
      - const: regs
      - const: data

required:
  - compatible
  - reg

if:
  properties:
    compatible:
      const: ti,nspire-cx-nand
then:
  properties:
    reg:
      minItems: 2
  required:
    - reg-names
else:
  properties:
    reg:
      maxItems: 1
    reg-names: false

unevaluatedProperties: false

examples:
  - |
    nand-controller@8fff1000 {
        compatible = "ti,nspire-cx-nand";
        reg = <0x8fff1000 0x1000>, <0x81000000 0x1000000>;
        reg-names = "regs", "data";
        #address-cells = <1>;
        #size-cells = <0>;

        nand@0 {
            reg = <0>;

            partitions {
                compatible = "fixed-partitions";
                #address-cells = <1>;
                #size-cells = <1>;

                partition@0 {
                    label = "manuf";
                    reg = <0x0 0x20000>;
                    read-only;
                };
            };
        };
    };
```

## Documentation/devicetree/bindings/nvmem/ti,nspire-bootrom.yaml
```yaml
# SPDX-License-Identifier: (GPL-2.0-only OR BSD-2-Clause)
%YAML 1.2
---
$id: http://devicetree.org/schemas/nvmem/ti,nspire-bootrom.yaml#
$schema: http://devicetree.org/meta-schemas/core.yaml#

title: TI-Nspire boot1 mask ROM

maintainers:
  - Krzysztof Kozlowski <krzk@kernel.org>

description:
  The 512 KiB mask ROM holding the first stage boot loader (boot1) of
  TI-Nspire calculators, exposed read-only.

allOf:
  - $ref: nvmem.yaml#

properties:
  compatible:
    const: ti,nspire-bootrom

  reg:
    maxItems: 1

required:
  - compatible
  - reg

unevaluatedProperties: false

examples:
  - |
    bootrom@0 {
        compatible = "ti,nspire-bootrom";
        reg = <0x00000000 0x80000>;
    };
```

## Documentation/devicetree/bindings/rtc/ti,nspire-rtc.yaml
```yaml
# SPDX-License-Identifier: (GPL-2.0-only OR BSD-2-Clause)
%YAML 1.2
---
$id: http://devicetree.org/schemas/rtc/ti,nspire-rtc.yaml#
$schema: http://devicetree.org/meta-schemas/core.yaml#

title: TI-Nspire Real Time Clock

maintainers:
  - Krzysztof Kozlowski <krzk@kernel.org>

description:
  Seconds counter with a single alarm found in TI-Nspire calculators. It
  resembles an ARM PL031 (and reports its PrimeCell ID) but its interrupt
  registers are laid out differently, so it is not an arm,pl031.

allOf:
  - $ref: rtc.yaml#

properties:
  compatible:
    const: ti,nspire-rtc

  reg:
    maxItems: 1

  interrupts:
    maxItems: 1

required:
  - compatible
  - reg

unevaluatedProperties: false

examples:
  - |
    rtc@90090000 {
        compatible = "ti,nspire-rtc";
        reg = <0x90090000 0x1000>;
        interrupts = <4>;
    };
```

## arch/sh/configs/fxcg20_defconfig
```kconfig
CONFIG_LOCALVERSION="-fxcg20"
# CONFIG_LOCALVERSION_AUTO is not set
CONFIG_DEFAULT_HOSTNAME="fxcg20"
# CONFIG_SWAP is not set
# CONFIG_CROSS_MEMORY_ATTACH is not set
CONFIG_LOG_BUF_SHIFT=12
CONFIG_BLK_DEV_INITRD=y
CONFIG_INITRAMFS_SOURCE="initramfs.list"
CONFIG_RD_GZIP=y
# CONFIG_RD_BZIP2 is not set
# CONFIG_RD_LZMA is not set
# CONFIG_RD_XZ is not set
# CONFIG_RD_LZO is not set
# CONFIG_RD_LZ4 is not set
# CONFIG_RD_ZSTD is not set
CONFIG_CC_OPTIMIZE_FOR_SIZE=y
CONFIG_EXPERT=y
# CONFIG_MULTIUSER is not set
# CONFIG_SGETMASK_SYSCALL is not set
# CONFIG_SYSFS_SYSCALL is not set
# CONFIG_FHANDLE is not set
# CONFIG_POSIX_TIMERS is not set
# CONFIG_BUG is not set
# CONFIG_ELF_CORE is not set
CONFIG_BASE_SMALL=y
# CONFIG_EPOLL is not set
# CONFIG_SIGNALFD is not set
# CONFIG_TIMERFD is not set
# CONFIG_EVENTFD is not set
# CONFIG_AIO is not set
# CONFIG_IO_URING is not set
# CONFIG_ADVISE_SYSCALLS is not set
# CONFIG_MEMBARRIER is not set
# CONFIG_KALLSYMS is not set
# CONFIG_RSEQ is not set
# CONFIG_CACHESTAT_SYSCALL is not set
# CONFIG_VM_EVENT_COUNTERS is not set
# CONFIG_COMPAT_BRK is not set
CONFIG_SLUB_TINY=y
CONFIG_CPU_SUBTYPE_SH7305=y
CONFIG_CPU_BIG_ENDIAN=y
# CONFIG_MMU is not set
CONFIG_MEMORY_START=0x08000000
CONFIG_MEMORY_SIZE=0x00200000
# CONFIG_SH_DSP is not set
# CONFIG_SH_STORE_QUEUES is not set
CONFIG_SH_FXCG=y
CONFIG_FXCG_STORAGE=y
CONFIG_SH_TIMER_TMU=y
CONFIG_HZ_100=y
CONFIG_KERNEL_XZ=y
CONFIG_CMDLINE_OVERWRITE=y
CONFIG_CMDLINE="console=ttyFX0 rdinit=/sbin/init"
# CONFIG_SUSPEND is not set
CONFIG_BINFMT_ELF_FDPIC=y
# CONFIG_BINFMT_FLAT is not set
# CONFIG_COREDUMP is not set
# CONFIG_BLOCK is not set
# CONFIG_NET is not set
# CONFIG_PREVENT_FIRMWARE_BUILD is not set
# CONFIG_FW_LOADER is not set
# CONFIG_ALLOW_DEV_COREDUMP is not set
# CONFIG_INPUT is not set
# CONFIG_SERIO is not set
# CONFIG_VT is not set
# CONFIG_LEGACY_PTYS is not set
# CONFIG_DEVMEM is not set
# CONFIG_HW_RANDOM is not set
# CONFIG_HWMON is not set
CONFIG_USB_GADGET=y
CONFIG_USB_R8A66597=y
CONFIG_USB_G_NCMDEV=y
# CONFIG_FILE_LOCKING is not set
# CONFIG_DNOTIFY is not set
# CONFIG_INOTIFY_USER is not set
CONFIG_TMPFS=y
# CONFIG_MISC_FILESYSTEMS is not set
# CONFIG_CRYPTO is not set
# CONFIG_XZ_DEC_X86 is not set
# CONFIG_XZ_DEC_POWERPC is not set
# CONFIG_XZ_DEC_ARM is not set
# CONFIG_XZ_DEC_ARMTHUMB is not set
# CONFIG_XZ_DEC_ARM64 is not set
# CONFIG_XZ_DEC_SPARC is not set
# CONFIG_XZ_DEC_RISCV is not set
# CONFIG_SYMBOLIC_ERRNAME is not set
# CONFIG_DEBUG_BUGVERBOSE is not set
# CONFIG_DEBUG_MISC is not set
# CONFIG_FTRACE is not set
# CONFIG_RUNTIME_TESTING_MENU is not set
# CONFIG_PERF_EVENTS is not set
# CONFIG_SECCOMP is not set
# CONFIG_SYSFS is not set
# CONFIG_PROC_SYSCTL is not set
# CONFIG_SYSCTL is not set
# CONFIG_DEBUG_KERNEL is not set
# CONFIG_PRINTK_INDEX is not set
# CONFIG_RANDOMIZE_KSTACK_OFFSET is not set
# CONFIG_IRQ_WORK is not set
# CONFIG_STACKPROTECTOR is not set
CONFIG_INIT_STACK_NONE=y
# CONFIG_FUTEX is not set
CONFIG_CRC32_BIT=y
# CONFIG_LEGACY_TIOCSTI is not set
# CONFIG_LDISC_AUTOLOAD is not set
# CONFIG_PROC_PAGE_MONITOR is not set
CONFIG_FLATMEM_MANUAL=y
CONFIG_ARCH_FORCE_MAX_ORDER=8
CONFIG_INITRAMFS_COMPRESSION_GZIP=y
CONFIG_LD_DEAD_CODE_DATA_ELIMINATION=y
```
